## app/build/Kconfig/Kconfig.modules
```kconfig
menu "nrf (/Users/pelli/Documents/GitHub/Testing-Cyber-physical-Systems-Using-NLP-Models-thesis-work-/nrf)"
osource "/Users/pelli/Documents/GitHub/Testing-Cyber-physical-Systems-Using-NLP-Models-thesis-work-/nrf/Kconfig.nrf"
config ZEPHYR_NRF_MODULE
	bool
	default y
endmenu
menu "mcuboot (/Users/pelli/Documents/GitHub/Testing-Cyber-physical-Systems-Using-NLP-Models-thesis-work-/bootloader/mcuboot)"
osource "$(ZEPHYR_MCUBOOT_KCONFIG)"
config ZEPHYR_MCUBOOT_MODULE
	bool
	default y
endmenu
menu "mbedtls (/Users/pelli/Documents/GitHub/Testing-Cyber-physical-Systems-Using-NLP-Models-thesis-work-/modules/crypto/mbedtls)"
osource "$(ZEPHYR_MBEDTLS_KCONFIG)"
config ZEPHYR_MBEDTLS_MODULE
	bool
	default y
endmenu
menu "oberon-psa-crypto (/Users/pelli/Documents/GitHub/Testing-Cyber-physical-Systems-Using-NLP-Models-thesis-work-/modules/crypto/oberon-psa-crypto)"
osource "/Users/pelli/Documents/GitHub/Testing-Cyber-physical-Systems-Using-NLP-Models-thesis-work-/modules/crypto/oberon-psa-crypto/Kconfig.oberon_psa_crypto"
config ZEPHYR_OBERON_PSA_CRYPTO_MODULE
	bool
	default y
endmenu
menu "trusted-firmware-m (/Users/pelli/Documents/GitHub/Testing-Cyber-physical-Systems-Using-NLP-Models-thesis-work-/modules/tee/tf-m/trusted-firmware-m)"
osource "$(ZEPHYR_TRUSTED_FIRMWARE_M_KCONFIG)"
config ZEPHYR_TRUSTED_FIRMWARE_M_MODULE
	bool
	default y
endmenu
config ZEPHYR_PSA_ARCH_TESTS_MODULE
	bool
	default y
menu "cjson (/Users/pelli/Documents/GitHub/Testing-Cyber-physical-Systems-Using-NLP-Models-thesis-work-/modules/lib/cjson)"
osource "$(ZEPHYR_CJSON_KCONFIG)"
config ZEPHYR_CJSON_MODULE
	bool
	default y
endmenu
menu "azure-sdk-for-c (/Users/pelli/Documents/GitHub/Testing-Cyber-physical-Systems-Using-NLP-Models-thesis-work-/modules/lib/azure-sdk-for-c)"
osource "$(ZEPHYR_AZURE_SDK_FOR_C_KCONFIG)"
config ZEPHYR_AZURE_SDK_FOR_C_MODULE
	bool
	default y
endmenu
menu "cirrus-logic (/Users/pelli/Documents/GitHub/Testing-Cyber-physical-Systems-Using-NLP-Models-thesis-work-/modules/hal/cirrus-logic)"
osource "/Users/pelli/Documents/GitHub/Testing-Cyber-physical-Systems-Using-NLP-Models-thesis-work-/modules/hal/cirrus-logic/Kconfig"
config ZEPHYR_CIRRUS_LOGIC_MODULE
	bool
	default y
endmenu
menu "openthread (/Users/pelli/Documents/GitHub/Testing-Cyber-physical-Systems-Using-NLP-Models-thesis-work-/modules/lib/openthread)"
osource "$(ZEPHYR_OPENTHREAD_KCONFIG)"
config ZEPHYR_OPENTHREAD_MODULE
	bool
	default y
endmenu
menu "suit-generator (/Users/pelli/Documents/GitHub/Testing-Cyber-physical-Systems-Using-NLP-Models-thesis-work-/modules/lib/suit-generator)"
osource "/Users/pelli/Documents/GitHub/Testing-Cyber-physical-Systems-Using-NLP-Models-thesis-work-/modules/lib/suit-generator/ncs/Kconfig"
config ZEPHYR_SUIT_GENERATOR_MODULE
	bool
	default y
endmenu
menu "suit-processor (/Users/pelli/Documents/GitHub/Testing-Cyber-physical-Systems-Using-NLP-Models-thesis-work-/modules/lib/suit-processor)"
osource "/Users/pelli/Documents/GitHub/Testing-Cyber-physical-Systems-Using-NLP-Models-thesis-work-/modules/lib/suit-processor/Kconfig"
config ZEPHYR_SUIT_PROCESSOR_MODULE
	bool
	default y
endmenu
menu "memfault-firmware-sdk (/Users/pelli/Documents/GitHub/Testing-Cyber-physical-Systems-Using-NLP-Models-thesis-work-/modules/lib/memfault-firmware-sdk)"
osource "/Users/pelli/Documents/GitHub/Testing-Cyber-physical-Systems-Using-NLP-Models-thesis-work-/modules/lib/memfault-firmware-sdk/ports/zephyr/Kconfig"
config ZEPHYR_MEMFAULT_FIRMWARE_SDK_MODULE
	bool
	default y
endmenu
menu "coremark (/Users/pelli/Documents/GitHub/Testing-Cyber-physical-Systems-Using-NLP-Models-thesis-work-/modules/benchmark/coremark)"
osource "$(ZEPHYR_COREMARK_KCONFIG)"
config ZEPHYR_COREMARK_MODULE
	bool
	default y
endmenu
menu "canopennode (/Users/pelli/Documents/GitHub/Testing-Cyber-physical-Systems-Using-NLP-Models-thesis-work-/modules/lib/canopennode)"
osource "$(ZEPHYR_CANOPENNODE_KCONFIG)"
config ZEPHYR_CANOPENNODE_MODULE
	bool
	default y
endmenu
menu "chre (/Users/pelli/Documents/GitHub/Testing-Cyber-physical-Systems-Using-NLP-Models-thesis-work-/modules/lib/chre)"
osource "/Users/pelli/Documents/GitHub/Testing-Cyber-physical-Systems-Using-NLP-Models-thesis-work-/modules/lib/chre/platform/zephyr/Kconfig"
config ZEPHYR_CHRE_MODULE
	bool
	default y
endmenu
menu "lz4 (/Users/pelli/Documents/GitHub/Testing-Cyber-physical-Systems-Using-NLP-Models-thesis-work-/modules/lib/lz4)"
osource "$(ZEPHYR_LZ4_KCONFIG)"
config ZEPHYR_LZ4_MODULE
	bool
	default y
endmenu
menu "nanopb (/Users/pelli/Documents/GitHub/Testing-Cyber-physical-Systems-Using-NLP-Models-thesis-work-/modules/lib/nanopb)"
osource "$(ZEPHYR_NANOPB_KCONFIG)"
config ZEPHYR_NANOPB_MODULE
	bool
	default y
endmenu
config ZEPHYR_TF_M_TESTS_MODULE
	bool
	default y
menu "zscilib (/Users/pelli/Documents/GitHub/Testing-Cyber-physical-Systems-Using-NLP-Models-thesis-work-/modules/lib/zscilib)"
osource "/Users/pelli/Documents/GitHub/Testing-Cyber-physical-Systems-Using-NLP-Models-thesis-work-/modules/lib/zscilib/Kconfig.zscilib"
config ZEPHYR_ZSCILIB_MODULE
	bool
	default y
endmenu
menu "cmsis (/Users/pelli/Documents/GitHub/Testing-Cyber-physical-Systems-Using-NLP-Models-thesis-work-/modules/hal/cmsis)"
osource "$(ZEPHYR_CMSIS_KCONFIG)"
config ZEPHYR_CMSIS_MODULE
	bool
	default y
endmenu
menu "cmsis-dsp (/Users/pelli/Documents/GitHub/Testing-Cyber-physical-Systems-Using-NLP-Models-thesis-work-/modules/lib/cmsis-dsp)"
osource "$(ZEPHYR_CMSIS_DSP_KCONFIG)"
config ZEPHYR_CMSIS_DSP_MODULE
	bool
	default y
endmenu
menu "cmsis-nn (/Users/pelli/Documents/GitHub/Testing-Cyber-physical-Systems-Using-NLP-Models-thesis-work-/modules/lib/cmsis-nn)"
osource "$(ZEPHYR_CMSIS_NN_KCONFIG)"
config ZEPHYR_CMSIS_NN_MODULE
	bool
	default y
endmenu
menu "fatfs (/Users/pelli/Documents/GitHub/Testing-Cyber-physical-Systems-Using-NLP-Models-thesis-work-/modules/fs/fatfs)"
osource "$(ZEPHYR_FATFS_KCONFIG)"
config ZEPHYR_FATFS_MODULE
	bool
	default y
endmenu
menu "hal_nordic (/Users/pelli/Documents/GitHub/Testing-Cyber-physical-Systems-Using-NLP-Models-thesis-work-/modules/hal/nordic)"
osource "$(ZEPHYR_HAL_NORDIC_KCONFIG)"
config ZEPHYR_HAL_NORDIC_MODULE
	bool
	default y

config ZEPHYR_HAL_NORDIC_MODULE_BLOBS
	bool
endmenu
menu "hal_st (/Users/pelli/Documents/GitHub/Testing-Cyber-physical-Systems-Using-NLP-Models-thesis-work-/modules/hal/st)"
osource "$(ZEPHYR_HAL_ST_KCONFIG)"
config ZEPHYR_HAL_ST_MODULE
	bool
	default y
endmenu
menu "hal_tdk (/Users/pelli/Documents/GitHub/Testing-Cyber-physical-Systems-Using-NLP-Models-thesis-work-/modules/hal/tdk)"
osource "$(ZEPHYR_HAL_TDK_KCONFIG)"
config ZEPHYR_HAL_TDK_MODULE
	bool
	default y
endmenu
config ZEPHYR_HAL_WURTHELEKTRONIK_MODULE
	bool
	default y
menu "hostap (/Users/pelli/Documents/GitHub/Testing-Cyber-physical-Systems-Using-NLP-Models-thesis-work-/modules/lib/hostap)"
osource "$(ZEPHYR_HOSTAP_KCONFIG)"
config ZEPHYR_HOSTAP_MODULE
	bool
	default y
endmenu
menu "liblc3 (/Users/pelli/Documents/GitHub/Testing-Cyber-physical-Systems-Using-NLP-Models-thesis-work-/modules/lib/liblc3)"
osource "$(ZEPHYR_LIBLC3_KCONFIG)"
config ZEPHYR_LIBLC3_MODULE
	bool
	default y
endmenu
config ZEPHYR_LIBMETAL_MODULE
	bool
	default y
menu "littlefs (/Users/pelli/Documents/GitHub/Testing-Cyber-physical-Systems-Using-NLP-Models-thesis-work-/modules/fs/littlefs)"
osource "$(ZEPHYR_LITTLEFS_KCONFIG)"
config ZEPHYR_LITTLEFS_MODULE
	bool
	default y
endmenu
menu "loramac-node (/Users/pelli/Documents/GitHub/Testing-Cyber-physical-Systems-Using-NLP-Models-thesis-work-/modules/lib/loramac-node)"
osource "$(ZEPHYR_LORAMAC_NODE_KCONFIG)"
config ZEPHYR_LORAMAC_NODE_MODULE
	bool
	default y
endmenu
menu "lvgl (/Users/pelli/Documents/GitHub/Testing-Cyber-physical-Systems-Using-NLP-Models-thesis-work-/modules/lib/gui/lvgl)"
osource "/Users/pelli/Documents/GitHub/Testing-Cyber-physical-Systems-Using-NLP-Models-thesis-work-/modules/lib/gui/lvgl/zephyr/Kconfig"
config ZEPHYR_LVGL_MODULE
	bool
	default y
endmenu
config ZEPHYR_MIPI_SYS_T_MODULE
	bool
	default y
menu "nrf_wifi (/Users/pelli/Documents/GitHub/Testing-Cyber-physical-Systems-Using-NLP-Models-thesis-work-/modules/lib/nrf_wifi)"
osource "$(ZEPHYR_NRF_WIFI_KCONFIG)"
config ZEPHYR_NRF_WIFI_MODULE
	bool
	default y

config ZEPHYR_NRF_WIFI_MODULE_BLOBS
	bool
endmenu
config ZEPHYR_OPEN_AMP_MODULE
	bool
	default y
menu "percepio (/Users/pelli/Documents/GitHub/Testing-Cyber-physical-Systems-Using-NLP-Models-thesis-work-/modules/debug/percepio)"
osource "/Users/pelli/Documents/GitHub/Testing-Cyber-physical-Systems-Using-NLP-Models-thesis-work-/modules/debug/percepio/zephyr/Kconfig"
config ZEPHYR_PERCEPIO_MODULE
	bool
	default y
endmenu
menu "picolibc (/Users/pelli/Documents/GitHub/Testing-Cyber-physical-Systems-Using-NLP-Models-thesis-work-/modules/lib/picolibc)"
osource "/Users/pelli/Documents/GitHub/Testing-Cyber-physical-Systems-Using-NLP-Models-thesis-work-/modules/lib/picolibc/zephyr/Kconfig"
config ZEPHYR_PICOLIBC_MODULE
	bool
	default y
endmenu
menu "segger (/Users/pelli/Documents/GitHub/Testing-Cyber-physical-Systems-Using-NLP-Models-thesis-work-/modules/debug/segger)"
osource "$(ZEPHYR_SEGGER_KCONFIG)"
config ZEPHYR_SEGGER_MODULE
	bool
	default y
endmenu
config ZEPHYR_TINYCRYPT_MODULE
	bool
	default y
menu "uoscore-uedhoc (/Users/pelli/Documents/GitHub/Testing-Cyber-physical-Systems-Using-NLP-Models-thesis-work-/modules/lib/uoscore-uedhoc)"
osource "$(ZEPHYR_UOSCORE_UEDHOC_KCONFIG)"
config ZEPHYR_UOSCORE_UEDHOC_MODULE
	bool
	default y
endmenu
menu "zcbor (/Users/pelli/Documents/GitHub/Testing-Cyber-physical-Systems-Using-NLP-Models-thesis-work-/modules/lib/zcbor)"
osource "$(ZEPHYR_ZCBOR_KCONFIG)"
config ZEPHYR_ZCBOR_MODULE
	bool
	default y
endmenu
menu "nrfxlib (/Users/pelli/Documents/GitHub/Testing-Cyber-physical-Systems-Using-NLP-Models-thesis-work-/nrfxlib)"
osource "/Users/pelli/Documents/GitHub/Testing-Cyber-physical-Systems-Using-NLP-Models-thesis-work-/nrfxlib/Kconfig.nrfxlib"
config ZEPHYR_NRFXLIB_MODULE
	bool
	default y
endmenu
config ZEPHYR_NRF_HW_MODELS_MODULE
	bool
	default y
menu "connectedhomeip (/Users/pelli/Documents/GitHub/Testing-Cyber-physical-Systems-Using-NLP-Models-thesis-work-/modules/lib/matter)"
osource "/Users/pelli/Documents/GitHub/Testing-Cyber-physical-Systems-Using-NLP-Models-thesis-work-/modules/lib/matter/config/nrfconnect/chip-module/Kconfig"
config ZEPHYR_CONNECTEDHOMEIP_MODULE
	bool
	default y
endmenu
```

## app/build/Kconfig/arch/Kconfig
```kconfig
# Load Zephyr Arch Kconfig descriptions.
osource "/Users/pelli/documents/GitHub/Testing-Cyber-physical-Systems-Using-NLP-Models-thesis-work-/zephyr/arch/x86/Kconfig"
osource "/Users/pelli/documents/GitHub/Testing-Cyber-physical-Systems-Using-NLP-Models-thesis-work-/zephyr/arch/xtensa/Kconfig"
osource "/Users/pelli/documents/GitHub/Testing-Cyber-physical-Systems-Using-NLP-Models-thesis-work-/zephyr/arch/sparc/Kconfig"
osource "/Users/pelli/documents/GitHub/Testing-Cyber-physical-Systems-Using-NLP-Models-thesis-work-/zephyr/arch/riscv/Kconfig"
osource "/Users/pelli/documents/GitHub/Testing-Cyber-physical-Systems-Using-NLP-Models-thesis-work-/zephyr/arch/posix/Kconfig"
osource "/Users/pelli/documents/GitHub/Testing-Cyber-physical-Systems-Using-NLP-Models-thesis-work-/zephyr/arch/nios2/Kconfig"
osource "/Users/pelli/documents/GitHub/Testing-Cyber-physical-Systems-Using-NLP-Models-thesis-work-/zephyr/arch/mips/Kconfig"
osource "/Users/pelli/documents/GitHub/Testing-Cyber-physical-Systems-Using-NLP-Models-thesis-work-/zephyr/arch/arm64/Kconfig"
osource "/Users/pelli/documents/GitHub/Testing-Cyber-physical-Systems-Using-NLP-Models-thesis-work-/zephyr/arch/arm/Kconfig"
osource "/Users/pelli/documents/GitHub/Testing-Cyber-physical-Systems-Using-NLP-Models-thesis-work-/zephyr/arch/arc/Kconfig"
```

## app/build/Kconfig/boards/Kconfig.defconfig
```kconfig
# Load Zephyr board defconfig descriptions.
osource "/Users/pelli/documents/GitHub/Testing-Cyber-physical-Systems-Using-NLP-Models-thesis-work-/zephyr/boards/nordic/nrf5340dk/Kconfig.defconfig"
```

## app/build/Kconfig/boards/Kconfig.sysbuild
```kconfig
# Load Sysbuild board Kconfig descriptions.
osource "/Users/pelli/documents/GitHub/Testing-Cyber-physical-Systems-Using-NLP-Models-thesis-work-/zephyr/boards/nordic/nrf5340dk/Kconfig.sysbuild"
```
