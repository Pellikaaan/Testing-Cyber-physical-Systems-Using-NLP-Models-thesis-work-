## app/build/Kconfig/soc/Kconfig.soc
```kconfig
# Load SoC Kconfig descriptions.
osource "/Users/pelli/documents/GitHub/Testing-Cyber-physical-Systems-Using-NLP-Models-thesis-work-/zephyr/soc/xlnx/zynqmp/Kconfig.soc"
osource "/Users/pelli/documents/GitHub/Testing-Cyber-physical-Systems-Using-NLP-Models-thesis-work-/zephyr/soc/xlnx/zynq7000/Kconfig.soc"
osource "/Users/pelli/documents/GitHub/Testing-Cyber-physical-Systems-Using-NLP-Models-thesis-work-/zephyr/soc/xen/Kconfig.soc"
osource "/Users/pelli/documents/GitHub/Testing-Cyber-physical-Systems-Using-NLP-Models-thesis-work-/zephyr/soc/wch/ch32v/Kconfig.soc"
osource "/Users/pelli/documents/GitHub/Testing-Cyber-physical-Systems-Using-NLP-Models-thesis-work-/zephyr/soc/ti/simplelink/Kconfig.soc"
osource "/Users/pelli/documents/GitHub/Testing-Cyber-physical-Systems-Using-NLP-Models-thesis-work-/zephyr/soc/ti/lm3s6965/Kconfig.soc"
osource "/Users/pelli/documents/GitHub/Testing-Cyber-physical-Systems-Using-NLP-Models-thesis-work-/zephyr/soc/ti/k3/Kconfig.soc"
osource "/Users/pelli/documents/GitHub/Testing-Cyber-physical-Systems-Using-NLP-Models-thesis-work-/zephyr/soc/telink/tlsr/Kconfig.soc"
osource "/Users/pelli/documents/GitHub/Testing-Cyber-physical-Systems-Using-NLP-Models-thesis-work-/zephyr/soc/starfive/jh71xx/Kconfig.soc"
osource "/Users/pelli/documents/GitHub/Testing-Cyber-physical-Systems-Using-NLP-Models-thesis-work-/zephyr/soc/st/stm32/Kconfig.soc"
osource "/Users/pelli/documents/GitHub/Testing-Cyber-physical-Systems-Using-NLP-Models-thesis-work-/zephyr/soc/snps/qemu_arc/Kconfig.soc"
osource "/Users/pelli/documents/GitHub/Testing-Cyber-physical-Systems-Using-NLP-Models-thesis-work-/zephyr/soc/snps/nsim/arc_v/Kconfig.soc"
osource "/Users/pelli/documents/GitHub/Testing-Cyber-physical-Systems-Using-NLP-Models-thesis-work-/zephyr/soc/snps/nsim/arc_classic/Kconfig.soc"
osource "/Users/pelli/documents/GitHub/Testing-Cyber-physical-Systems-Using-NLP-Models-thesis-work-/zephyr/soc/snps/hsdk4xd/Kconfig.soc"
osource "/Users/pelli/documents/GitHub/Testing-Cyber-physical-Systems-Using-NLP-Models-thesis-work-/zephyr/soc/snps/hsdk/Kconfig.soc"
osource "/Users/pelli/documents/GitHub/Testing-Cyber-physical-Systems-Using-NLP-Models-thesis-work-/zephyr/soc/snps/emsk/Kconfig.soc"
osource "/Users/pelli/documents/GitHub/Testing-Cyber-physical-Systems-Using-NLP-Models-thesis-work-/zephyr/soc/snps/emsdp/Kconfig.soc"
osource "/Users/pelli/documents/GitHub/Testing-Cyber-physical-Systems-Using-NLP-Models-thesis-work-/zephyr/soc/snps/arc_iot/Kconfig.soc"
osource "/Users/pelli/documents/GitHub/Testing-Cyber-physical-Systems-Using-NLP-Models-thesis-work-/zephyr/soc/silabs/Kconfig.soc"
osource "/Users/pelli/documents/GitHub/Testing-Cyber-physical-Systems-Using-NLP-Models-thesis-work-/zephyr/soc/sifive/sifive_freedom/Kconfig.soc"
osource "/Users/pelli/documents/GitHub/Testing-Cyber-physical-Systems-Using-NLP-Models-thesis-work-/zephyr/soc/sensry/Kconfig.soc"
osource "/Users/pelli/documents/GitHub/Testing-Cyber-physical-Systems-Using-NLP-Models-thesis-work-/zephyr/soc/rockchip/Kconfig.soc"
osource "/Users/pelli/documents/GitHub/Testing-Cyber-physical-Systems-Using-NLP-Models-thesis-work-/zephyr/soc/renode/riscv_virtual/Kconfig.soc"
osource "/Users/pelli/documents/GitHub/Testing-Cyber-physical-Systems-Using-NLP-Models-thesis-work-/zephyr/soc/renode/cortex_r8_virtual/Kconfig.soc"
osource "/Users/pelli/documents/GitHub/Testing-Cyber-physical-Systems-Using-NLP-Models-thesis-work-/zephyr/soc/renesas/smartbond/Kconfig.soc"
osource "/Users/pelli/documents/GitHub/Testing-Cyber-physical-Systems-Using-NLP-Models-thesis-work-/zephyr/soc/renesas/rzt2m/Kconfig.soc"
osource "/Users/pelli/documents/GitHub/Testing-Cyber-physical-Systems-Using-NLP-Models-thesis-work-/zephyr/soc/renesas/rz/Kconfig.soc"
osource "/Users/pelli/documents/GitHub/Testing-Cyber-physical-Systems-Using-NLP-Models-thesis-work-/zephyr/soc/renesas/rcar/Kconfig.soc"
osource "/Users/pelli/documents/GitHub/Testing-Cyber-physical-Systems-Using-NLP-Models-thesis-work-/zephyr/soc/renesas/ra/Kconfig.soc"
osource "/Users/pelli/documents/GitHub/Testing-Cyber-physical-Systems-Using-NLP-Models-thesis-work-/zephyr/soc/realtek/ec/Kconfig.soc"
osource "/Users/pelli/documents/GitHub/Testing-Cyber-physical-Systems-Using-NLP-Models-thesis-work-/zephyr/soc/raspberrypi/rpi_pico/Kconfig.soc"
osource "/Users/pelli/documents/GitHub/Testing-Cyber-physical-Systems-Using-NLP-Models-thesis-work-/zephyr/soc/quicklogic/eos_s3/Kconfig.soc"
osource "/Users/pelli/documents/GitHub/Testing-Cyber-physical-Systems-Using-NLP-Models-thesis-work-/zephyr/soc/qemu/virt_riscv/Kconfig.soc"
osource "/Users/pelli/documents/GitHub/Testing-Cyber-physical-Systems-Using-NLP-Models-thesis-work-/zephyr/soc/qemu/malta/Kconfig.soc"
osource "/Users/pelli/documents/GitHub/Testing-Cyber-physical-Systems-Using-NLP-Models-thesis-work-/zephyr/soc/openisa/rv32m1/Kconfig.soc"
osource "/Users/pelli/documents/GitHub/Testing-Cyber-physical-Systems-Using-NLP-Models-thesis-work-/zephyr/soc/nxp/s32/Kconfig.soc"
osource "/Users/pelli/documents/GitHub/Testing-Cyber-physical-Systems-Using-NLP-Models-thesis-work-/zephyr/soc/nxp/rw/Kconfig.soc"
osource "/Users/pelli/documents/GitHub/Testing-Cyber-physical-Systems-Using-NLP-Models-thesis-work-/zephyr/soc/nxp/mcx/Kconfig.soc"
osource "/Users/pelli/documents/GitHub/Testing-Cyber-physical-Systems-Using-NLP-Models-thesis-work-/zephyr/soc/nxp/lpc/Kconfig.soc"
osource "/Users/pelli/documents/GitHub/Testing-Cyber-physical-Systems-Using-NLP-Models-thesis-work-/zephyr/soc/nxp/layerscape/Kconfig.soc"
osource "/Users/pelli/documents/GitHub/Testing-Cyber-physical-Systems-Using-NLP-Models-thesis-work-/zephyr/soc/nxp/kinetis/Kconfig.soc"
osource "/Users/pelli/documents/GitHub/Testing-Cyber-physical-Systems-Using-NLP-Models-thesis-work-/zephyr/soc/nxp/imxrt/Kconfig.soc"
osource "/Users/pelli/documents/GitHub/Testing-Cyber-physical-Systems-Using-NLP-Models-thesis-work-/zephyr/soc/nxp/imx/Kconfig.soc"
osource "/Users/pelli/documents/GitHub/Testing-Cyber-physical-Systems-Using-NLP-Models-thesis-work-/zephyr/soc/nuvoton/numicro/Kconfig.soc"
osource "/Users/pelli/documents/GitHub/Testing-Cyber-physical-Systems-Using-NLP-Models-thesis-work-/zephyr/soc/nuvoton/numaker/Kconfig.soc"
osource "/Users/pelli/documents/GitHub/Testing-Cyber-physical-Systems-Using-NLP-Models-thesis-work-/zephyr/soc/nuvoton/npcx/Kconfig.soc"
osource "/Users/pelli/documents/GitHub/Testing-Cyber-physical-Systems-Using-NLP-Models-thesis-work-/zephyr/soc/nuvoton/npcm/Kconfig.soc"
osource "/Users/pelli/documents/GitHub/Testing-Cyber-physical-Systems-Using-NLP-Models-thesis-work-/zephyr/soc/nordic/Kconfig.soc"
osource "/Users/pelli/documents/GitHub/Testing-Cyber-physical-Systems-Using-NLP-Models-thesis-work-/zephyr/soc/neorv32/Kconfig.soc"
osource "/Users/pelli/documents/GitHub/Testing-Cyber-physical-Systems-Using-NLP-Models-thesis-work-/zephyr/soc/native/inf_clock/Kconfig.soc"
osource "/Users/pelli/documents/GitHub/Testing-Cyber-physical-Systems-Using-NLP-Models-thesis-work-/zephyr/soc/microchip/miv/Kconfig.soc"
osource "/Users/pelli/documents/GitHub/Testing-Cyber-physical-Systems-Using-NLP-Models-thesis-work-/zephyr/soc/microchip/mec/Kconfig.soc"
osource "/Users/pelli/documents/GitHub/Testing-Cyber-physical-Systems-Using-NLP-Models-thesis-work-/zephyr/soc/mediatek/mt8xxx/Kconfig.soc"
osource "/Users/pelli/documents/GitHub/Testing-Cyber-physical-Systems-Using-NLP-Models-thesis-work-/zephyr/soc/lowrisc/opentitan/Kconfig.soc"
osource "/Users/pelli/documents/GitHub/Testing-Cyber-physical-Systems-Using-NLP-Models-thesis-work-/zephyr/soc/litex/litex_vexriscv/Kconfig.soc"
osource "/Users/pelli/documents/GitHub/Testing-Cyber-physical-Systems-Using-NLP-Models-thesis-work-/zephyr/soc/ite/ec/Kconfig.soc"
osource "/Users/pelli/documents/GitHub/Testing-Cyber-physical-Systems-Using-NLP-Models-thesis-work-/zephyr/soc/intel/raptor_lake/Kconfig.soc"
osource "/Users/pelli/documents/GitHub/Testing-Cyber-physical-Systems-Using-NLP-Models-thesis-work-/zephyr/soc/intel/lakemont/Kconfig.soc"
osource "/Users/pelli/documents/GitHub/Testing-Cyber-physical-Systems-Using-NLP-Models-thesis-work-/zephyr/soc/intel/intel_socfpga_std/Kconfig.soc"
osource "/Users/pelli/documents/GitHub/Testing-Cyber-physical-Systems-Using-NLP-Models-thesis-work-/zephyr/soc/intel/intel_socfpga/Kconfig.soc"
osource "/Users/pelli/documents/GitHub/Testing-Cyber-physical-Systems-Using-NLP-Models-thesis-work-/zephyr/soc/intel/intel_niosv/Kconfig.soc"
osource "/Users/pelli/documents/GitHub/Testing-Cyber-physical-Systems-Using-NLP-Models-thesis-work-/zephyr/soc/intel/intel_ish/Kconfig.soc"
osource "/Users/pelli/documents/GitHub/Testing-Cyber-physical-Systems-Using-NLP-Models-thesis-work-/zephyr/soc/intel/intel_adsp/Kconfig.soc"
osource "/Users/pelli/documents/GitHub/Testing-Cyber-physical-Systems-Using-NLP-Models-thesis-work-/zephyr/soc/intel/elkhart_lake/Kconfig.soc"
osource "/Users/pelli/documents/GitHub/Testing-Cyber-physical-Systems-Using-NLP-Models-thesis-work-/zephyr/soc/intel/atom/Kconfig.soc"
osource "/Users/pelli/documents/GitHub/Testing-Cyber-physical-Systems-Using-NLP-Models-thesis-work-/zephyr/soc/intel/apollo_lake/Kconfig.soc"
osource "/Users/pelli/documents/GitHub/Testing-Cyber-physical-Systems-Using-NLP-Models-thesis-work-/zephyr/soc/intel/alder_lake/Kconfig.soc"
osource "/Users/pelli/documents/GitHub/Testing-Cyber-physical-Systems-Using-NLP-Models-thesis-work-/zephyr/soc/infineon/cat3/Kconfig.soc"
osource "/Users/pelli/documents/GitHub/Testing-Cyber-physical-Systems-Using-NLP-Models-thesis-work-/zephyr/soc/infineon/cat1b/Kconfig.soc"
osource "/Users/pelli/documents/GitHub/Testing-Cyber-physical-Systems-Using-NLP-Models-thesis-work-/zephyr/soc/infineon/cat1a/Kconfig.soc"
osource "/Users/pelli/documents/GitHub/Testing-Cyber-physical-Systems-Using-NLP-Models-thesis-work-/zephyr/soc/gd/gd32/Kconfig.soc"
osource "/Users/pelli/documents/GitHub/Testing-Cyber-physical-Systems-Using-NLP-Models-thesis-work-/zephyr/soc/gaisler/leon3/Kconfig.soc"
osource "/Users/pelli/documents/GitHub/Testing-Cyber-physical-Systems-Using-NLP-Models-thesis-work-/zephyr/soc/gaisler/gr716a/Kconfig.soc"
osource "/Users/pelli/documents/GitHub/Testing-Cyber-physical-Systems-Using-NLP-Models-thesis-work-/zephyr/soc/espressif/Kconfig.soc"
osource "/Users/pelli/documents/GitHub/Testing-Cyber-physical-Systems-Using-NLP-Models-thesis-work-/zephyr/soc/ene/kb1200/Kconfig.soc"
osource "/Users/pelli/documents/GitHub/Testing-Cyber-physical-Systems-Using-NLP-Models-thesis-work-/zephyr/soc/efinix/sapphire/Kconfig.soc"
osource "/Users/pelli/documents/GitHub/Testing-Cyber-physical-Systems-Using-NLP-Models-thesis-work-/zephyr/soc/cdns/xtensa_sample_controller/Kconfig.soc"
osource "/Users/pelli/documents/GitHub/Testing-Cyber-physical-Systems-Using-NLP-Models-thesis-work-/zephyr/soc/cdns/sample_controller32/Kconfig.soc"
osource "/Users/pelli/documents/GitHub/Testing-Cyber-physical-Systems-Using-NLP-Models-thesis-work-/zephyr/soc/cdns/dc233c/Kconfig.soc"
osource "/Users/pelli/documents/GitHub/Testing-Cyber-physical-Systems-Using-NLP-Models-thesis-work-/zephyr/soc/brcm/bcmvk/Kconfig.soc"
osource "/Users/pelli/documents/GitHub/Testing-Cyber-physical-Systems-Using-NLP-Models-thesis-work-/zephyr/soc/brcm/bcm2712/Kconfig.soc"
osource "/Users/pelli/documents/GitHub/Testing-Cyber-physical-Systems-Using-NLP-Models-thesis-work-/zephyr/soc/brcm/bcm2711/Kconfig.soc"
osource "/Users/pelli/documents/GitHub/Testing-Cyber-physical-Systems-Using-NLP-Models-thesis-work-/zephyr/soc/atmel/sam0/Kconfig.soc"
osource "/Users/pelli/documents/GitHub/Testing-Cyber-physical-Systems-Using-NLP-Models-thesis-work-/zephyr/soc/atmel/sam/Kconfig.soc"
osource "/Users/pelli/documents/GitHub/Testing-Cyber-physical-Systems-Using-NLP-Models-thesis-work-/zephyr/soc/aspeed/Kconfig.soc"
osource "/Users/pelli/documents/GitHub/Testing-Cyber-physical-Systems-Using-NLP-Models-thesis-work-/zephyr/soc/arm/Kconfig.soc"
osource "/Users/pelli/documents/GitHub/Testing-Cyber-physical-Systems-Using-NLP-Models-thesis-work-/zephyr/soc/arm/beetle/Kconfig.soc"
osource "/Users/pelli/documents/GitHub/Testing-Cyber-physical-Systems-Using-NLP-Models-thesis-work-/zephyr/soc/antmicro/myra/Kconfig.soc"
osource "/Users/pelli/documents/GitHub/Testing-Cyber-physical-Systems-Using-NLP-Models-thesis-work-/zephyr/soc/andestech/Kconfig.soc"
osource "/Users/pelli/documents/GitHub/Testing-Cyber-physical-Systems-Using-NLP-Models-thesis-work-/zephyr/soc/amd/acp_6_0/Kconfig.soc"
osource "/Users/pelli/documents/GitHub/Testing-Cyber-physical-Systems-Using-NLP-Models-thesis-work-/zephyr/soc/ambiq/Kconfig.soc"
osource "/Users/pelli/documents/GitHub/Testing-Cyber-physical-Systems-Using-NLP-Models-thesis-work-/zephyr/soc/altr/zephyr_nios2f/Kconfig.soc"
osource "/Users/pelli/documents/GitHub/Testing-Cyber-physical-Systems-Using-NLP-Models-thesis-work-/zephyr/soc/altr/qemu_nios2/Kconfig.soc"
osource "/Users/pelli/documents/GitHub/Testing-Cyber-physical-Systems-Using-NLP-Models-thesis-work-/zephyr/soc/adi/max32/Kconfig.soc"
```
