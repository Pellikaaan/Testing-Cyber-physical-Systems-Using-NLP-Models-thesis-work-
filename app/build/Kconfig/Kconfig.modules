## app/build/Kconfig/soc/Kconfig
```kconfig
# Load Zephyr SoC Kconfig descriptions.
osource "/Users/pelli/documents/GitHub/Testing-Cyber-physical-Systems-Using-NLP-Models-thesis-work-/zephyr/soc/xlnx/zynqmp/Kconfig"
osource "/Users/pelli/documents/GitHub/Testing-Cyber-physical-Systems-Using-NLP-Models-thesis-work-/zephyr/soc/xlnx/zynq7000/Kconfig"
osource "/Users/pelli/documents/GitHub/Testing-Cyber-physical-Systems-Using-NLP-Models-thesis-work-/zephyr/soc/xen/Kconfig"
osource "/Users/pelli/documents/GitHub/Testing-Cyber-physical-Systems-Using-NLP-Models-thesis-work-/zephyr/soc/wch/ch32v/Kconfig"
osource "/Users/pelli/documents/GitHub/Testing-Cyber-physical-Systems-Using-NLP-Models-thesis-work-/zephyr/soc/ti/simplelink/Kconfig"
osource "/Users/pelli/documents/GitHub/Testing-Cyber-physical-Systems-Using-NLP-Models-thesis-work-/zephyr/soc/ti/lm3s6965/Kconfig"
osource "/Users/pelli/documents/GitHub/Testing-Cyber-physical-Systems-Using-NLP-Models-thesis-work-/zephyr/soc/ti/k3/Kconfig"
osource "/Users/pelli/documents/GitHub/Testing-Cyber-physical-Systems-Using-NLP-Models-thesis-work-/zephyr/soc/telink/tlsr/Kconfig"
osource "/Users/pelli/documents/GitHub/Testing-Cyber-physical-Systems-Using-NLP-Models-thesis-work-/zephyr/soc/starfive/jh71xx/Kconfig"
osource "/Users/pelli/documents/GitHub/Testing-Cyber-physical-Systems-Using-NLP-Models-thesis-work-/zephyr/soc/st/stm32/Kconfig"
osource "/Users/pelli/documents/GitHub/Testing-Cyber-physical-Systems-Using-NLP-Models-thesis-work-/zephyr/soc/snps/qemu_arc/Kconfig"
osource "/Users/pelli/documents/GitHub/Testing-Cyber-physical-Systems-Using-NLP-Models-thesis-work-/zephyr/soc/snps/nsim/arc_v/Kconfig"
osource "/Users/pelli/documents/GitHub/Testing-Cyber-physical-Systems-Using-NLP-Models-thesis-work-/zephyr/soc/snps/nsim/arc_classic/Kconfig"
osource "/Users/pelli/documents/GitHub/Testing-Cyber-physical-Systems-Using-NLP-Models-thesis-work-/zephyr/soc/snps/hsdk4xd/Kconfig"
osource "/Users/pelli/documents/GitHub/Testing-Cyber-physical-Systems-Using-NLP-Models-thesis-work-/zephyr/soc/snps/hsdk/Kconfig"
osource "/Users/pelli/documents/GitHub/Testing-Cyber-physical-Systems-Using-NLP-Models-thesis-work-/zephyr/soc/snps/emsk/Kconfig"
osource "/Users/pelli/documents/GitHub/Testing-Cyber-physical-Systems-Using-NLP-Models-thesis-work-/zephyr/soc/snps/emsdp/Kconfig"
osource "/Users/pelli/documents/GitHub/Testing-Cyber-physical-Systems-Using-NLP-Models-thesis-work-/zephyr/soc/snps/arc_iot/Kconfig"
osource "/Users/pelli/documents/GitHub/Testing-Cyber-physical-Systems-Using-NLP-Models-thesis-work-/zephyr/soc/silabs/Kconfig"
osource "/Users/pelli/documents/GitHub/Testing-Cyber-physical-Systems-Using-NLP-Models-thesis-work-/zephyr/soc/sifive/sifive_freedom/Kconfig"
osource "/Users/pelli/documents/GitHub/Testing-Cyber-physical-Systems-Using-NLP-Models-thesis-work-/zephyr/soc/sensry/Kconfig"
osource "/Users/pelli/documents/GitHub/Testing-Cyber-physical-Systems-Using-NLP-Models-thesis-work-/zephyr/soc/rockchip/Kconfig"
osource "/Users/pelli/documents/GitHub/Testing-Cyber-physical-Systems-Using-NLP-Models-thesis-work-/zephyr/soc/renode/riscv_virtual/Kconfig"
osource "/Users/pelli/documents/GitHub/Testing-Cyber-physical-Systems-Using-NLP-Models-thesis-work-/zephyr/soc/renode/cortex_r8_virtual/Kconfig"
osource "/Users/pelli/documents/GitHub/Testing-Cyber-physical-Systems-Using-NLP-Models-thesis-work-/zephyr/soc/renesas/smartbond/Kconfig"
osource "/Users/pelli/documents/GitHub/Testing-Cyber-physical-Systems-Using-NLP-Models-thesis-work-/zephyr/soc/renesas/rzt2m/Kconfig"
osource "/Users/pelli/documents/GitHub/Testing-Cyber-physical-Systems-Using-NLP-Models-thesis-work-/zephyr/soc/renesas/rz/Kconfig"
osource "/Users/pelli/documents/GitHub/Testing-Cyber-physical-Systems-Using-NLP-Models-thesis-work-/zephyr/soc/renesas/rcar/Kconfig"
osource "/Users/pelli/documents/GitHub/Testing-Cyber-physical-Systems-Using-NLP-Models-thesis-work-/zephyr/soc/renesas/ra/Kconfig"
osource "/Users/pelli/documents/GitHub/Testing-Cyber-physical-Systems-Using-NLP-Models-thesis-work-/zephyr/soc/realtek/ec/Kconfig"
osource "/Users/pelli/documents/GitHub/Testing-Cyber-physical-Systems-Using-NLP-Models-thesis-work-/zephyr/soc/raspberrypi/rpi_pico/Kconfig"
osource "/Users/pelli/documents/GitHub/Testing-Cyber-physical-Systems-Using-NLP-Models-thesis-work-/zephyr/soc/quicklogic/eos_s3/Kconfig"
osource "/Users/pelli/documents/GitHub/Testing-Cyber-physical-Systems-Using-NLP-Models-thesis-work-/zephyr/soc/qemu/virt_riscv/Kconfig"
osource "/Users/pelli/documents/GitHub/Testing-Cyber-physical-Systems-Using-NLP-Models-thesis-work-/zephyr/soc/qemu/malta/Kconfig"
osource "/Users/pelli/documents/GitHub/Testing-Cyber-physical-Systems-Using-NLP-Models-thesis-work-/zephyr/soc/openisa/rv32m1/Kconfig"
osource "/Users/pelli/documents/GitHub/Testing-Cyber-physical-Systems-Using-NLP-Models-thesis-work-/zephyr/soc/nxp/s32/Kconfig"
osource "/Users/pelli/documents/GitHub/Testing-Cyber-physical-Systems-Using-NLP-Models-thesis-work-/zephyr/soc/nxp/rw/Kconfig"
osource "/Users/pelli/documents/GitHub/Testing-Cyber-physical-Systems-Using-NLP-Models-thesis-work-/zephyr/soc/nxp/mcx/Kconfig"
osource "/Users/pelli/documents/GitHub/Testing-Cyber-physical-Systems-Using-NLP-Models-thesis-work-/zephyr/soc/nxp/lpc/Kconfig"
osource "/Users/pelli/documents/GitHub/Testing-Cyber-physical-Systems-Using-NLP-Models-thesis-work-/zephyr/soc/nxp/layerscape/Kconfig"
osource "/Users/pelli/documents/GitHub/Testing-Cyber-physical-Systems-Using-NLP-Models-thesis-work-/zephyr/soc/nxp/kinetis/Kconfig"
osource "/Users/pelli/documents/GitHub/Testing-Cyber-physical-Systems-Using-NLP-Models-thesis-work-/zephyr/soc/nxp/imxrt/Kconfig"
osource "/Users/pelli/documents/GitHub/Testing-Cyber-physical-Systems-Using-NLP-Models-thesis-work-/zephyr/soc/nxp/imx/Kconfig"
osource "/Users/pelli/documents/GitHub/Testing-Cyber-physical-Systems-Using-NLP-Models-thesis-work-/zephyr/soc/nuvoton/numicro/Kconfig"
osource "/Users/pelli/documents/GitHub/Testing-Cyber-physical-Systems-Using-NLP-Models-thesis-work-/zephyr/soc/nuvoton/numaker/Kconfig"
osource "/Users/pelli/documents/GitHub/Testing-Cyber-physical-Systems-Using-NLP-Models-thesis-work-/zephyr/soc/nuvoton/npcx/Kconfig"
osource "/Users/pelli/documents/GitHub/Testing-Cyber-physical-Systems-Using-NLP-Models-thesis-work-/zephyr/soc/nuvoton/npcm/Kconfig"
osource "/Users/pelli/documents/GitHub/Testing-Cyber-physical-Systems-Using-NLP-Models-thesis-work-/zephyr/soc/nordic/Kconfig"
osource "/Users/pelli/documents/GitHub/Testing-Cyber-physical-Systems-Using-NLP-Models-thesis-work-/zephyr/soc/neorv32/Kconfig"
osource "/Users/pelli/documents/GitHub/Testing-Cyber-physical-Systems-Using-NLP-Models-thesis-work-/zephyr/soc/native/inf_clock/Kconfig"
osource "/Users/pelli/documents/GitHub/Testing-Cyber-physical-Systems-Using-NLP-Models-thesis-work-/zephyr/soc/microchip/miv/Kconfig"
osource "/Users/pelli/documents/GitHub/Testing-Cyber-physical-Systems-Using-NLP-Models-thesis-work-/zephyr/soc/microchip/mec/Kconfig"
osource "/Users/pelli/documents/GitHub/Testing-Cyber-physical-Systems-Using-NLP-Models-thesis-work-/zephyr/soc/mediatek/mt8xxx/Kconfig"
osource "/Users/pelli/documents/GitHub/Testing-Cyber-physical-Systems-Using-NLP-Models-thesis-work-/zephyr/soc/lowrisc/opentitan/Kconfig"
osource "/Users/pelli/documents/GitHub/Testing-Cyber-physical-Systems-Using-NLP-Models-thesis-work-/zephyr/soc/litex/litex_vexriscv/Kconfig"
osource "/Users/pelli/documents/GitHub/Testing-Cyber-physical-Systems-Using-NLP-Models-thesis-work-/zephyr/soc/ite/ec/Kconfig"
osource "/Users/pelli/documents/GitHub/Testing-Cyber-physical-Systems-Using-NLP-Models-thesis-work-/zephyr/soc/intel/raptor_lake/Kconfig"
osource "/Users/pelli/documents/GitHub/Testing-Cyber-physical-Systems-Using-NLP-Models-thesis-work-/zephyr/soc/intel/lakemont/Kconfig"
osource "/Users/pelli/documents/GitHub/Testing-Cyber-physical-Systems-Using-NLP-Models-thesis-work-/zephyr/soc/intel/intel_socfpga_std/Kconfig"
osource "/Users/pelli/documents/GitHub/Testing-Cyber-physical-Systems-Using-NLP-Models-thesis-work-/zephyr/soc/intel/intel_socfpga/Kconfig"
osource "/Users/pelli/documents/GitHub/Testing-Cyber-physical-Systems-Using-NLP-Models-thesis-work-/zephyr/soc/intel/intel_niosv/Kconfig"
osource "/Users/pelli/documents/GitHub/Testing-Cyber-physical-Systems-Using-NLP-Models-thesis-work-/zephyr/soc/intel/intel_ish/Kconfig"
osource "/Users/pelli/documents/GitHub/Testing-Cyber-physical-Systems-Using-NLP-Models-thesis-work-/zephyr/soc/intel/intel_adsp/Kconfig"
osource "/Users/pelli/documents/GitHub/Testing-Cyber-physical-Systems-Using-NLP-Models-thesis-work-/zephyr/soc/intel/elkhart_lake/Kconfig"
osource "/Users/pelli/documents/GitHub/Testing-Cyber-physical-Systems-Using-NLP-Models-thesis-work-/zephyr/soc/intel/atom/Kconfig"
osource "/Users/pelli/documents/GitHub/Testing-Cyber-physical-Systems-Using-NLP-Models-thesis-work-/zephyr/soc/intel/apollo_lake/Kconfig"
osource "/Users/pelli/documents/GitHub/Testing-Cyber-physical-Systems-Using-NLP-Models-thesis-work-/zephyr/soc/intel/alder_lake/Kconfig"
osource "/Users/pelli/documents/GitHub/Testing-Cyber-physical-Systems-Using-NLP-Models-thesis-work-/zephyr/soc/infineon/cat3/Kconfig"
osource "/Users/pelli/documents/GitHub/Testing-Cyber-physical-Systems-Using-NLP-Models-thesis-work-/zephyr/soc/infineon/cat1b/Kconfig"
osource "/Users/pelli/documents/GitHub/Testing-Cyber-physical-Systems-Using-NLP-Models-thesis-work-/zephyr/soc/infineon/cat1a/Kconfig"
osource "/Users/pelli/documents/GitHub/Testing-Cyber-physical-Systems-Using-NLP-Models-thesis-work-/zephyr/soc/gd/gd32/Kconfig"
osource "/Users/pelli/documents/GitHub/Testing-Cyber-physical-Systems-Using-NLP-Models-thesis-work-/zephyr/soc/gaisler/leon3/Kconfig"
osource "/Users/pelli/documents/GitHub/Testing-Cyber-physical-Systems-Using-NLP-Models-thesis-work-/zephyr/soc/gaisler/gr716a/Kconfig"
osource "/Users/pelli/documents/GitHub/Testing-Cyber-physical-Systems-Using-NLP-Models-thesis-work-/zephyr/soc/espressif/Kconfig"
osource "/Users/pelli/documents/GitHub/Testing-Cyber-physical-Systems-Using-NLP-Models-thesis-work-/zephyr/soc/ene/kb1200/Kconfig"
osource "/Users/pelli/documents/GitHub/Testing-Cyber-physical-Systems-Using-NLP-Models-thesis-work-/zephyr/soc/efinix/sapphire/Kconfig"
osource "/Users/pelli/documents/GitHub/Testing-Cyber-physical-Systems-Using-NLP-Models-thesis-work-/zephyr/soc/cdns/xtensa_sample_controller/Kconfig"
osource "/Users/pelli/documents/GitHub/Testing-Cyber-physical-Systems-Using-NLP-Models-thesis-work-/zephyr/soc/cdns/sample_controller32/Kconfig"
osource "/Users/pelli/documents/GitHub/Testing-Cyber-physical-Systems-Using-NLP-Models-thesis-work-/zephyr/soc/cdns/dc233c/Kconfig"
osource "/Users/pelli/documents/GitHub/Testing-Cyber-physical-Systems-Using-NLP-Models-thesis-work-/zephyr/soc/brcm/bcmvk/Kconfig"
osource "/Users/pelli/documents/GitHub/Testing-Cyber-physical-Systems-Using-NLP-Models-thesis-work-/zephyr/soc/brcm/bcm2712/Kconfig"
osource "/Users/pelli/documents/GitHub/Testing-Cyber-physical-Systems-Using-NLP-Models-thesis-work-/zephyr/soc/brcm/bcm2711/Kconfig"
osource "/Users/pelli/documents/GitHub/Testing-Cyber-physical-Systems-Using-NLP-Models-thesis-work-/zephyr/soc/atmel/sam0/Kconfig"
osource "/Users/pelli/documents/GitHub/Testing-Cyber-physical-Systems-Using-NLP-Models-thesis-work-/zephyr/soc/atmel/sam/Kconfig"
osource "/Users/pelli/documents/GitHub/Testing-Cyber-physical-Systems-Using-NLP-Models-thesis-work-/zephyr/soc/aspeed/Kconfig"
osource "/Users/pelli/documents/GitHub/Testing-Cyber-physical-Systems-Using-NLP-Models-thesis-work-/zephyr/soc/arm/Kconfig"
osource "/Users/pelli/documents/GitHub/Testing-Cyber-physical-Systems-Using-NLP-Models-thesis-work-/zephyr/soc/arm/beetle/Kconfig"
osource "/Users/pelli/documents/GitHub/Testing-Cyber-physical-Systems-Using-NLP-Models-thesis-work-/zephyr/soc/antmicro/myra/Kconfig"
osource "/Users/pelli/documents/GitHub/Testing-Cyber-physical-Systems-Using-NLP-Models-thesis-work-/zephyr/soc/andestech/Kconfig"
osource "/Users/pelli/documents/GitHub/Testing-Cyber-physical-Systems-Using-NLP-Models-thesis-work-/zephyr/soc/amd/acp_6_0/Kconfig"
osource "/Users/pelli/documents/GitHub/Testing-Cyber-physical-Systems-Using-NLP-Models-thesis-work-/zephyr/soc/ambiq/Kconfig"
osource "/Users/pelli/documents/GitHub/Testing-Cyber-physical-Systems-Using-NLP-Models-thesis-work-/zephyr/soc/altr/zephyr_nios2f/Kconfig"
osource "/Users/pelli/documents/GitHub/Testing-Cyber-physical-Systems-Using-NLP-Models-thesis-work-/zephyr/soc/altr/qemu_nios2/Kconfig"
osource "/Users/pelli/documents/GitHub/Testing-Cyber-physical-Systems-Using-NLP-Models-thesis-work-/zephyr/soc/adi/max32/Kconfig"
```
