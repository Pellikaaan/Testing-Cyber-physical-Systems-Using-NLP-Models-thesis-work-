## CMakeLists.txt
```
# CMakeLists.txt for the app

cmake_minimum_required(VERSION 3.20.0)
find_package(Zephyr REQUIRED HINTS $ENV{ZEPHYR_BASE})
project(app)

target_sources(app PRIVATE src/main.c)
# Explicitly enable Bluetooth in the CMake configuration
target_compile_definitions(app PRIVATE CONFIG_BT)
```

## prj.conf
```kconfig
# Enable essential features
CONFIG_MAIN_STACK_SIZE=4096
CONFIG_HEAP_MEM_POOL_SIZE=16384
CONFIG_SYS_CLOCK_TICKS_PER_SEC=1000

# Enable Bluetooth support (if needed)
CONFIG_BT=y
CONFIG_BT_PERIPHERAL=y
CONFIG_BT_DEVICE_NAME="BLE_KORT"

# Disable central role if only peripheral is required
# CONFIG_BT_CENTRAL=y

CONFIG_BT_GATT_SERVICE_CHANGED=y
CONFIG_BT_DEVICE_APPEARANCE=0
CONFIG_CONSOLE=y
CONFIG_SERIAL=y
CONFIG_UART_CONSOLE=y

# Remove unnecessary HCI configuration
# CONFIG_BT_HCI=y
# CONFIG_BT_HCI_VS=n

CONFIG_LOG=y
CONFIG_LOG_DEFAULT_LEVEL=4

CONFIG_BT=y
CONFIG_BT_CENTRAL=y
CONFIG_BT_PERIPHERAL=y
CONFIG_BT_OBSERVER=y

CONFIG_BT_MAX_CONN=1
```

## src/main.c
```c
#include <zephyr/kernel.h>
#include <zephyr/types.h>
#include <zephyr/bluetooth/bluetooth.h>
#include <zephyr/bluetooth/hci.h>
#include <zephyr/bluetooth/conn.h>
#include <zephyr/bluetooth/gap.h>
#include <zephyr/sys/printk.h>

void main(void)
{
    int err;
    printk("Starting BLE Peripheral... huehue\n");

    err = bt_enable(NULL);
    if (err) {
        printk("Bluetooth init failed (err %d)\n", err);
        return;
    }

    printk("Bluetooth initialized\n");

    const struct bt_le_adv_param *adv_param = BT_LE_ADV_CONN_NAME;
    
    err = bt_le_adv_start(adv_param, NULL, 0, NULL, 0);
    if (err) {
        printk("Advertising failed to start (err %d)\n", err);
        return;
    }

    printk("Advertising started\n");
}
```
